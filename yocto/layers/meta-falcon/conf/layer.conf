## yocto/layers/meta-falcon/conf/layer.conf
```bitbake
# We have a conf and classes directory, add to BBPATH
BBPATH .= ":${LAYERDIR}"

# We have recipes-* directories, add to BBFILES
BBFILES += "${LAYERDIR}/recipes-*/*/*.bb \
            ${LAYERDIR}/recipes-*/*/*.bbappend"

BBFILE_COLLECTIONS += "falcon"
BBFILE_PATTERN_falcon = "^${LAYERDIR}/"
BBFILE_PRIORITY_falcon = "6"

LAYERDEPENDS_falcon = "core"
LAYERSERIES_COMPAT_falcon = "whinlatter"
```
